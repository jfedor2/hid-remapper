/ {
    aliases {
        led0 = &led0;
        led1 = &led2;
        sw0 = &button0;
    };

	buttons {
		compatible = "gpio-keys";
		button0: button_0 {
			gpios = <&gpio0 2 (GPIO_PULL_UP | GPIO_ACTIVE_LOW)>;
			label = "Push button switch";
		};
	};
};
