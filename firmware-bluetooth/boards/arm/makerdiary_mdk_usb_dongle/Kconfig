## firmware-bluetooth/boards/arm/makerdiary_mdk_usb_dongle/Kconfig
```kconfig
config BOARD_ENABLE_DCDC
	bool "DCDC mode"
	select SOC_DCDC_NRF52X
	default y
	depends on BOARD_MAKERDIARY_MDK_USB_DONGLE
```

## firmware-bluetooth/boards/arm/makerdiary_mdk_usb_dongle/Kconfig.board
```kconfig
config BOARD_MAKERDIARY_MDK_USB_DONGLE
	bool "Makerdiary nRF52840 MDK USB Dongle (Adafruit UF2 bootloader, S140 6.1.1)"
	depends on SOC_NRF52840_QIAA
```

## firmware-bluetooth/boards/arm/makerdiary_mdk_usb_dongle/Kconfig.defconfig
```kconfig
if BOARD_MAKERDIARY_MDK_USB_DONGLE

config BOARD
	default "makerdiary_mdk_usb_dongle"

config BT_CTLR
	default BT

endif # BOARD_MAKERDIARY_MDK_USB_DONGLE
```

## firmware-bluetooth/boards/arm/nice_nano/Kconfig.board
```kconfig
# nice!nano board configuration

# Copyright (c) 2020 Tobias Svehagen
# SPDX-License-Identifier: Apache-2.0

config BOARD_NICE_NANO
	bool "nice!nano"
	depends on SOC_NRF52840_QIAA
```

## firmware-bluetooth/boards/arm/nice_nano/Kconfig.defconfig
```kconfig
# nice!nano board configuration

# Copyright (c) 2020 Tobias Svehagen
# SPDX-License-Identifier: Apache-2.0

if BOARD_NICE_NANO

config BOARD
	default "nice_nano"

config BT_CTLR
	default BT

endif # BOARD_NICE_NANO
```
