## firmware-bluetooth/boards/arm/mdbt50q_cx_40_dongle/Kconfig.board
```kconfig
# Raytac MDBT50Q-CX-40 Dongle board configuration
# SPDX-License-Identifier: Apache-2.0

config BOARD_MDBT50Q_CX_40_DONGLE_NRF52840
        bool "Raytac MDBT50Q-CX-40 Dongle"
        depends on SOC_NRF52840_QIAA
```

## firmware-bluetooth/boards/arm/mdbt50q_cx_40_dongle/Kconfig.defconfig
```kconfig
# SPDX-License-Identifier: Apache-2.0

if BOARD_MDBT50Q_CX_40_DONGLE_NRF52840

config BOARD
        default "mdbt50q_cx_40_dongle_nrf52840"

config BT_CTLR
        default BT

config FLASH_LOAD_OFFSET
        default 0x1000

config FLASH_LOAD_SIZE
        default 0xeb000

endif # BOARD_MDBT50Q_CX_40_DONGLE_NRF52840
```

## firmware-bluetooth/boards/arm/mdbt50q_cx_40_dongle/mdbt50q_cx_40_dongle_nrf52840_defconfig
```kconfig
# SPDX-License-Identifier: Apache-2.0

CONFIG_SOC_SERIES_NRF52X=y
CONFIG_SOC_NRF52840_QIAA=y
CONFIG_BOARD_MDBT50Q_CX_40_DONGLE_NRF52840=y

# Enable MPU
CONFIG_ARM_MPU=y

# Enable GPIO
CONFIG_GPIO=y

# Enable UART
CONFIG_SERIAL=y

# Board options
CONFIG_GPIO_AS_PINRESET=y
CONFIG_PINCTRL=y

# Nordic nRF5 DFU bootloader support: link app after Nordic MBR at 0x1000
# CONFIG_BOARD_HAS_NRF5_BOOTLOADER=y
# CONFIG_FLASH_LOAD_OFFSET=0x1000
# CONFIG_FLASH_LOAD_SIZE=0xeb000

# USB: disable remote wakeup (nrfx driver conflict)
CONFIG_USB_DEVICE_REMOTE_WAKEUP=n
```

## firmware-bluetooth/boards/arm/seeed_xiao_nrf52840/Kconfig.board
```kconfig
# Seeed Studio XIAO nRF52840 board configuration

# Copyright (c) 2020 Tobias Svehagen
# SPDX-License-Identifier: Apache-2.0

config BOARD_SEEED_XIAO_NRF52840
	bool "Seeed Studio XIAO nRF52840"
	depends on SOC_NRF52840_QIAA
```

## firmware-bluetooth/boards/arm/seeed_xiao_nrf52840/Kconfig.defconfig
```kconfig
# Seeed Studio XIAO nRF52840 board configuration

# Copyright (c) 2020 Tobias Svehagen
# SPDX-License-Identifier: Apache-2.0

if BOARD_SEEED_XIAO_NRF52840

config BOARD
	default "seeed_xiao_nrf52840"

config BT_CTLR
	default BT

endif # BOARD_SEEED_XIAO_NRF52840
```

## west.yml
```yaml
manifest:
  remotes:
    - name: ncs
      url-base: https://github.com/nrfconnect

  projects:
    - name: nrf
      remote: ncs
      repo-path: sdk-nrf
      revision: v3.2.0
      import: true
```
